## drivers/accel/igna/Kconfig
```kconfig
# SPDX-License-Identifier: GPL-2.0-only
#
# Intel(R) Gaussian & Neural Accelerator (Intel(R) GNA)
#

config DRM_ACCEL_IGNA
	tristate "Intel(R) Gaussian & Neural Accelerator (Intel(R) GNA)"
	depends on DRM_ACCEL
	depends on X86 && PCI
	help
	  This option enables the Intel(R) Gaussian & Neural Accelerator
	  (Intel(R) GNA) driver: gna
	  User space interface is defined in include/uapi/drm/igna_accel.h, while
	  information about functionality is in
	  Documentation/accel/igna.rst
```
